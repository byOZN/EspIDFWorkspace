## test/main/Kconfig.projbuild
```kconfig
menu "Example Configuration"

    orsource "$IDF_PATH/examples/common_components/env_caps/$IDF_TARGET/Kconfig.env_caps"

    config SINGLE_LED_GPIO
        int "Single Led GPIO number"
        range ENV_GPIO_RANGE_MIN ENV_GPIO_OUT_RANGE_MAX
        default 14
        help
            GPIO number single led

    config BUTTON_GPIO
        int "Button GPIO number"
        range ENV_GPIO_RANGE_MIN ENV_GPIO_OUT_RANGE_MAX
        default 45
        help
            GPIO number (IOxx) to blink on and off the LED.

endmenu

menu "WIFI Config"
    config WIFI_SSID
        string "WIFI SSID"
        default "ssid"
        help
            Wifi ssid WPA or WPA2

    config WIFI_PASS
        string "WIFI PASS"
        default "wifi_pass"
        help
            Wifi password
endmenu

menu "Server Config"
    config UPLOAD_URL
        string "CSV upload URL"
        default "http://192.168.1.100:8080/api/upload"
        help
            Full URL for HTTP POST of the CSV file.
            Example: http://192.168.1.100:8080/api/measurements
endmenu

menu "LedStrip Config"

    orsource "$IDF_PATH/examples/common_components/env_caps/$IDF_TARGET/Kconfig.env_caps"

    choice BLINK_LED
        prompt "Blink LED type"
        default BLINK_LED_GPIO
        help
            Select the LED type.

        config BLINK_LED_GPIO
            bool "GPIO"
        config BLINK_LED_STRIP
            bool "LED strip"
    endchoice

    choice BLINK_LED_STRIP_BACKEND
        depends on BLINK_LED_STRIP
        prompt "LED strip backend peripheral"
        default BLINK_LED_STRIP_BACKEND_RMT if SOC_RMT_SUPPORTED
        default BLINK_LED_STRIP_BACKEND_SPI

        config BLINK_LED_STRIP_BACKEND_RMT
            depends on SOC_RMT_SUPPORTED
            bool "RMT"
        config BLINK_LED_STRIP_BACKEND_SPI
            bool "SPI"
    endchoice

    config BLINK_GPIO
        int "Blink GPIO number"
        range ENV_GPIO_RANGE_MIN ENV_GPIO_OUT_RANGE_MAX
        default 48
        help
            GPIO number for addressable LED strip.

    config BLINK_PERIOD
        int "Blink period in ms"
        range 10 3600000
        default 1000

endmenu
```
